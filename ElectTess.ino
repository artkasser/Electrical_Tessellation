#include <Wire.h> // I2C library, required for MLX90614
#include <SparkFunMLX90614.h> // SparkFunMLX90614 Arduino library

IRTherm therm; // Create an IRTherm object to interact with throughout

#include <avr/pgmspace.h>

int YMport = 0;
byte YMvalue = 0;
byte YMregister = 0;

unsigned long previousMillisVGM = millis();
unsigned long pausemiliseconds = 0;

unsigned int previousMicrosVGM = micros();
unsigned int pausemicroseconds = 0;

const int YM_IC = 5;  // IC //In old configuration was 8 //Originally was A5, please change
const int YM_CS = 4;  //CS //In old configuration was 7 //Originally was A4, please change
const int YM_WR = 3;  //WR //In old configuration was A3
const int YM_RD = 2;  //RD //In old configuration was A2
const int YM_A0 = A1;  //A0 //In old configuration was A0
const int YM_A1 = A0;  //A1 //In old configuration was A1
const int pindataYM = A2; //In old configuration was 2 //Originally was 3, please change
const int pinclockYM = A3;  //In old configuration was 3 //Originally was 4, please change
const int pindataLED = 11; //In old configuration was 4
const int pinlatchLED = 12; //In old configuration was 5
const int pinclockLED = 13; //In old configuration was 6

uint16_t ONESAMPLE = 23;
uint16_t Samples = 0;
uint16_t vgmpos = 0;


byte bytenote = B00000000;
boolean songfinished = false;
boolean firsttime[] = {true, true, true};
boolean animationstatus[] = {false, false, false};
int frameanimation[] = {0, 0, 0};

int frametime = 20; // 20 ms is 50 fps; 40 ms is 25 fps;
unsigned long previousmillisFrame = millis();
byte OffsetTriggerTemp = 4;
boolean firsttimeTemp = true;

boolean vgmplayerStatus = false;
boolean channelstatus[] = {false, false, false, false, false, false};
int framechannel[] = {0, 0, 0, 0, 0, 0};

int oldsong = 0;
int song = 0;

int TempSensorStatus = 0;
boolean PreviousTempState = false;
int screen = 0;

const byte Heartbeat [] PROGMEM = {
  0x52, 0x22, 0x08, 0x52, 0x27, 0x00, 0x52, 0xB4, 0xC0, 0x52, 0xB5, 0xC0, 0x52, 0xB6, 0xC0, 0x53,
  0xB4, 0xC0, 0x53, 0xB5, 0xC0, 0x53, 0xB6, 0xC0, 0x52, 0x28, 0x00, 0x52, 0x28, 0x01, 0x52, 0x28,
  0x02, 0x52, 0x28, 0x03, 0x52, 0x28, 0x04, 0x52, 0x28, 0x05, 0x52, 0x28, 0x06, 0x50, 0x9F, 0x50,
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  0xF1, 0x61, 0xE8, 0x44, 0x52, 0x28, 0x01, 0x61, 0xD0, 0x89, 0x66
};

const byte Joy01 [] PROGMEM = {
  0x52, 0x22, 0x08, 0x52, 0x27, 0x00, 0x52, 0xB4, 0xC0, 0x52, 0xB5, 0xC0, 0x52, 0xB6, 0xC0, 0x53,
  0xB4, 0xC0, 0x53, 0xB5, 0xC0, 0x53, 0xB6, 0xC0, 0x52, 0x28, 0x00, 0x52, 0x28, 0x01, 0x52, 0x28,
  0x02, 0x52, 0x28, 0x03, 0x52, 0x28, 0x04, 0x52, 0x28, 0x05, 0x52, 0x28, 0x06, 0x50, 0x9F, 0x50,
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  0x3A, 0x11, 0x52, 0x28, 0x04, 0x52, 0x28, 0x05, 0x52, 0x28, 0x06, 0x61, 0xAE, 0x33, 0x66
};

const byte Joy02 [] PROGMEM = {
  0x52, 0x22, 0x08, 0x52, 0x27, 0x00, 0x52, 0xB4, 0xC0, 0x52, 0xB5, 0xC0, 0x52, 0xB6, 0xC0, 0x53,
  0xB4, 0xC0, 0x53, 0xB5, 0xC0, 0x53, 0xB6, 0xC0, 0x52, 0x28, 0x00, 0x52, 0x28, 0x01, 0x52, 0x28,
  0x02, 0x52, 0x28, 0x03, 0x52, 0x28, 0x04, 0x52, 0x28, 0x05, 0x52, 0x28, 0x06, 0x50, 0x9F, 0x50,
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  0x52, 0x28, 0x06, 0x61, 0xAE, 0x33, 0x66
};

const byte Joy03 [] PROGMEM = {
  0x52, 0x22, 0x08, 0x52, 0x27, 0x00, 0x52, 0xB4, 0xC0, 0x52, 0xB5, 0xC0, 0x52, 0xB6, 0xC0, 0x53,
  0xB4, 0xC0, 0x53, 0xB5, 0xC0, 0x53, 0xB6, 0xC0, 0x52, 0x28, 0x00, 0x52, 0x28, 0x01, 0x52, 0x28,
  0x02, 0x52, 0x28, 0x03, 0x52, 0x28, 0x04, 0x52, 0x28, 0x05, 0x52, 0x28, 0x06, 0x50, 0x9F, 0x50,
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  0x28, 0x06, 0x61, 0xAE, 0x33, 0x66
};

const byte SadOrder01 [] PROGMEM = {
  0x52, 0x22, 0x08, 0x52, 0x27, 0x00, 0x52, 0xB4, 0xC0, 0x52, 0xB5, 0xC0, 0x52, 0xB6, 0xC0, 0x53,
  0xB4, 0xC0, 0x53, 0xB5, 0xC0, 0x53, 0xB6, 0xC0, 0x52, 0x28, 0x00, 0x52, 0x28, 0x01, 0x52, 0x28,
  0x02, 0x52, 0x28, 0x03, 0x52, 0x28, 0x04, 0x52, 0x28, 0x05, 0x52, 0x28, 0x06, 0x50, 0x9F, 0x50,
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  0x33, 0x66
};

const byte SadOrder02 [] PROGMEM = {
  0x52, 0x22, 0x08, 0x52, 0x27, 0x00, 0x52, 0xB4, 0xC0, 0x52, 0xB5, 0xC0, 0x52, 0xB6, 0xC0, 0x53,
  0xB4, 0xC0, 0x53, 0xB5, 0xC0, 0x53, 0xB6, 0xC0, 0x52, 0x28, 0x00, 0x52, 0x28, 0x01, 0x52, 0x28,
  0x02, 0x52, 0x28, 0x03, 0x52, 0x28, 0x04, 0x52, 0x28, 0x05, 0x52, 0x28, 0x06, 0x50, 0x9F, 0x50,
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  0x05, 0x52, 0x28, 0x06, 0x61, 0xAE, 0x33, 0x66
};

const byte SadOrder03 [] PROGMEM = {
  0x52, 0x22, 0x08, 0x52, 0x27, 0x00, 0x52, 0xB4, 0xC0, 0x52, 0xB5, 0xC0, 0x52, 0xB6, 0xC0, 0x53,
  0xB4, 0xC0, 0x53, 0xB5, 0xC0, 0x53, 0xB6, 0xC0, 0x52, 0x28, 0x00, 0x52, 0x28, 0x01, 0x52, 0x28,
  0x02, 0x52, 0x28, 0x03, 0x52, 0x28, 0x04, 0x52, 0x28, 0x05, 0x52, 0x28, 0x06, 0x50, 0x9F, 0x50,
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  0x61, 0x22, 0x56, 0x52, 0x28, 0x04, 0x52, 0x28, 0x05, 0x52, 0x28, 0x06, 0x61, 0xAE, 0x33, 0x66
};


void setup() {

  Serial.begin(9600);

  /*
     IR Thermometer
  */
  therm.begin(); // Initialize thermal IR sensor
  therm.setUnit(TEMP_C); // Set the library's units to Celsius
  // Alternatively, TEMP_C can be replaced with TEMP_K for Fahrenheit or
  // TEMP_K for Kelvin.

  pinMode(YM_IC, OUTPUT);
  pinMode(YM_CS, OUTPUT);
  pinMode(YM_WR, OUTPUT);
  pinMode(YM_RD, OUTPUT);
  pinMode(YM_A0, OUTPUT);
  pinMode(YM_A1, OUTPUT);

  pinMode(pindataYM, OUTPUT);
  pinMode(pinclockYM, OUTPUT);

  pinMode(pindataLED, OUTPUT);
  pinMode(pinlatchLED, OUTPUT);
  pinMode(pinclockLED, OUTPUT);

  digitalWrite(YM_A1, LOW);
  digitalWrite(YM_A0, LOW);

  digitalWrite(YM_CS, HIGH);
  digitalWrite(YM_WR, HIGH);
  digitalWrite(YM_IC, HIGH);
  digitalWrite(YM_RD, HIGH);

  /* Reset YM2612 */
  digitalWrite(YM_IC, LOW);
  delay(10);
  digitalWrite(YM_IC, HIGH);
  delay(10);

}

void loop() {

  vgmplayer();
  logchannelYM2612();

  unsigned long currentmillisFrame = millis();
  if (currentmillisFrame - previousmillisFrame > frametime) {
    previousmillisFrame = currentmillisFrame;
    ReadInput();
    UpdateWorld();
    ShowOutput();
  }
}

byte vgmdata() {
  switch (song) {
    case (0):
      return pgm_read_byte_near(Heartbeat + vgmpos);
      break;
    case (1):
      return pgm_read_byte_near(Joy01 + vgmpos);
      break;
    case (2):
      return pgm_read_byte_near(SadOrder01 + vgmpos);
      break;
    case (3):
      return pgm_read_byte_near(Joy02 + vgmpos);
      break;
    case (4):
      return pgm_read_byte_near(SadOrder02 + vgmpos);
      break;
    case (5):
      return pgm_read_byte_near(Joy03 + vgmpos);
      break;
    case (6):
      return pgm_read_byte_near(SadOrder03 + vgmpos);
      break;
    default:
      break;
  }
}
/*
  void ResetGame()
  {
  SilenceAllChannels();
  WriteLED(0);
  song = 0; //Heartbeat
  oldsong = 0;
  vgmpos = 0;
  firsttime = true;
  delay(120000);
  }
*/
void vgmplayer() {
  if (vgmplayerStatus == true) {
    unsigned long currentMillisVGM = millis();
    unsigned int currentMicrosVGM = micros();
    if ((currentMicrosVGM - previousMicrosVGM) >= pausemicroseconds) {
      if ((currentMillisVGM - previousMillisVGM) >= pausemiliseconds) {
        previousMillisVGM = currentMillisVGM;
        byte vgmcase = vgmdata();
        switch (vgmcase)
        {
          case 0x50: // 0x50 dd : PSG (SN76489/SN76496) write value dd
            vgmpos++;
            vgmpos++;
            pausemicroseconds = 0;
            pausemiliseconds = 0;
            break;

          case 0x52: // 0x52 aa dd : YM2612 port 0, write value dd to register aa
            vgmpos++;
            YMregister = vgmdata();
            vgmpos++;
            YMvalue = vgmdata();
            setreg(0, YMregister, YMvalue);
            vgmpos++;
            pausemicroseconds = 0;
            pausemiliseconds = 0;
            break;

          case 0x53: // 0x53 aa dd : YM2612 port 1, write value dd to register aa
            vgmpos++;
            YMregister = vgmdata();
            vgmpos++;
            YMvalue = vgmdata();
            setreg(1, YMregister, YMvalue);
            vgmpos++;
            pausemicroseconds = 0;
            pausemiliseconds = 0;
            break;

          case 0x61: // 0x61 nn nn : Wait n samples, n can range from 0 to 65535
            vgmpos++;
            Samples = (uint16_t)( vgmdata() & 0x00FF );
            vgmpos++;
            Samples |= (uint16_t)((vgmdata() << 8) & 0xFF00 );
            vgmpos++;
            //delay(Samples * 0.023);
            pausemicroseconds = 0;
            pausemiliseconds = Samples * 0.023;
            break;

          case 0x62: // wait 735 samples (60th of a second)
            vgmpos++;
            //delay(17);
            pausemicroseconds = 0;
            pausemiliseconds = 17;
            break;

          case 0x63: // wait 882 samples (50th of a second)
            vgmpos++;
            //delay(20);
            pausemicroseconds = 0;
            pausemiliseconds = 20;
            break;

          case 0x66: // 0x66 : end of sound data
            vgmpos = 0;
            SilenceAllChannels();
            vgmplayerStatus = false;
            songfinished = true;
            pausemicroseconds = 0;
            pausemiliseconds = 0; // It must be zero. Change for tests
            break;

          case 0x70: // 0x7n : wait n+1 samples, n can range from 0 to 15
          case 0x71:
          case 0x72:
          case 0x73:
          case 0x74:
          case 0x75:
          case 0x76:
          case 0x77:
          case 0x78:
          case 0x79:
          case 0x7a:
          case 0x7b:
          case 0x7c:
          case 0x7d:
          case 0x7e:
          case 0x7f:
            Samples = vgmdata() & 0x0F;
            Samples++;
            vgmpos++;
            pausemicroseconds = Samples * ONESAMPLE;
            pausemiliseconds = 0;
            break;
          default:
            break;
        } //end switch
      }
    }
  }
}

void logchannelYM2612() {

  if (YMregister == 0x28) {  // Key on/off in Operators from 1 to 4
    if (YMvalue == 0xF0) { // Key on in Operators from 1 to 4 in Channel 1
      channelstatus[0] = true;
    }
    if (YMvalue == 0xF1) { // Key on in Operators from 1 to 4 in Channel 2
      channelstatus[1] = true;
    }
    if (YMvalue == 0xF2) { // Key on in Operators from 1 to 4 in Channel 3
      channelstatus[2] = true;
    }
    if (YMvalue == 0xF4) { // Key on in Operators from 1 to 4 in Channel 4
      channelstatus[3] = true;
    }
    if (YMvalue == 0xF5) { // Key on in Operators from 1 to 4 in Channel 5
      channelstatus[4] = true;
    }
    if (YMvalue == 0xF6) { // Key on in Operators from 1 to 4 in Channel 6
      channelstatus[5] = true;
    }
  }

  YMregister = 0x00;
  YMvalue = 0x00;

}

void WriteLED(byte data) {
  digitalWrite(pinlatchLED, LOW);
  shiftOut(pindataLED, pinclockLED, MSBFIRST, data);
  digitalWrite(pinlatchLED, HIGH);
}

void WriteYMData(byte data) {
  shiftOut(pindataYM, pinclockYM, MSBFIRST, data);
}

void setreg(int port, byte addr, byte data) {
  switch (port) {
    case (0):
      digitalWrite( YM_A0, LOW);    /* A0 = 0 for register addres write */
      digitalWrite( YM_A1, LOW);
      delayMicroseconds(2);
      break;
    case (1):
      digitalWrite( YM_A0, LOW);    /* A0 = 0 for register addres write */
      digitalWrite( YM_A1, HIGH);
      break;
    default:
      break;
  }
  digitalWrite( YM_CS, LOW);    /* CS low to select */
  WriteYMData(addr);
  digitalWrite( YM_WR, LOW);
  delayMicroseconds(2);
  digitalWrite( YM_WR, HIGH);
  digitalWrite( YM_CS, HIGH);    /* CS high */
  delayMicroseconds(2);

  switch (port) {
    case (0):
      digitalWrite( YM_A0, HIGH);    /* A0 = 1 for register data write */
      digitalWrite( YM_A1, LOW);
      delayMicroseconds(2);
      break;
    case (1):
      digitalWrite( YM_A0, HIGH);    /* A0 = 1 for register data write */
      digitalWrite( YM_A1, HIGH);
      delayMicroseconds(2);
      break;
    default:
      break;
  }
  digitalWrite(YM_CS, LOW);    /* CS low to select */
  WriteYMData(data);
  digitalWrite(YM_WR, LOW);
  delayMicroseconds(2);
  digitalWrite(YM_WR, HIGH);
  digitalWrite(YM_CS, HIGH);    /* CS high */
}

void SilenceAllChannels() {
  setreg(0, 0x28, 0x00); // Note off (channel 0)
  setreg(0, 0x28, 0x01); // Note off (channel 1)
  setreg(0, 0x28, 0x02); // Note off (channel 2)
  setreg(0, 0x28, 0x04); // Note off (channel 3)
  setreg(0, 0x28, 0x05); // Note off (channel 4)
  setreg(0, 0x28, 0x06); // Note off (channel 5)
}

void ReadInput() {
  // Temperature
  byte AmbTemp = 20;
  byte MeasTemp = 21;
  byte TriggerTemp = 24;

  if (firsttimeTemp == true) {
    if (therm.read()) { // On success, read() will return 1, on fail 0. This function takes 1.3 milliseconds
      AmbTemp = therm.ambient();
    }
    firsttimeTemp = false;
  }

  if (firsttimeTemp == false) {
    if (therm.read()) { // On success, read() will return 1, on fail 0. This function takes 1.3 milliseconds
      MeasTemp = therm.object();
    }
    TriggerTemp = AmbTemp + OffsetTriggerTemp;
    boolean CurrentTempState = (MeasTemp > TriggerTemp);

    if (PreviousTempState == false) {
      if (CurrentTempState == false) {
        TempSensorStatus = 0; // Still released
      }
      if (CurrentTempState == true) {
        TempSensorStatus =  2; // Just pressed
      }
    }
    if (PreviousTempState == true) {
      if (CurrentTempState == false) {
        TempSensorStatus =  1; // Just released
      }
      if (CurrentTempState == true) {
        TempSensorStatus =  3; // Still pressed
      }
    }
    PreviousTempState = CurrentTempState;
  }
}

void UpdateWorld() {
  int totalframeanimation[] = {100, 100, 100}; //100 frames --> 2 seconds with a 50 fps rate
  switch (screen) {
    case (0):
      if (firsttime[screen] == true) { // Turn everything off
        firsttime[screen] = false;
        SilenceAllChannels();
        WriteLED(0);
        vgmplayerStatus = false;
      }
      if (firsttime[screen] == false) {
        if (animationstatus[screen] == false) {
          if (TempSensorStatus == 2) { //Just pressed
            animationstatus[screen] = true;
          }
        }
        else {
          if (frameanimation[screen] < totalframeanimation[screen]) {
            Animation (screen, frameanimation[screen], totalframeanimation[screen]);
            frameanimation[screen]++;
          }
          else {
            frameanimation[screen] = 0;
            animationstatus[screen] = false;
            firsttime[screen] = true;
            screen = 1; // it must be 1
            OffsetTriggerTemp = 6; //Look for numbers between 6 and 8
          }
        }
      }
      break;

    case (1):
      if (firsttime[screen] == true) { // Turn everything off
        firsttime[screen] = false;
        SilenceAllChannels();
        WriteLED(0);
        vgmplayerStatus = true;
        song = 0;
        vgmpos = 0;
      }
      if (firsttime[screen] == false) {
        if (animationstatus[screen] == false) {
          channel2LED();
          if (TempSensorStatus == 2) { //Just pressed
            animationstatus[screen] = true;
            vgmplayerStatus = false;
            song = oldsong + 1;
          }
          if (songfinished == true) { // Drums loop. If song finishes it will start again
            songfinished = false;
            vgmplayerStatus = true;
          }
        }
        else {
          if (frameanimation[screen] < totalframeanimation[screen]) {
            Animation (screen, frameanimation[screen], totalframeanimation[screen]);
            frameanimation[screen]++;
          }
          else {
            frameanimation[screen] = 0;
            animationstatus[screen] = false;
            firsttime[screen] = true;
            if (song < 7) {
              screen = 2;
            }
            else {
              song = 1;
              oldsong = 0;
              vgmpos = 0;
              screen = 3;
            }
          }
        }
      }
      break;

    case (2):
      if (firsttime[screen] == true) { // Turn everything off
        firsttime[screen] = false;
        SilenceAllChannels();
        WriteLED(0);
        vgmplayerStatus = true;
        vgmpos = 0;
      }
      if (firsttime[screen] == false) {
        if (animationstatus[screen] == false) {
          channel2LED();

          if (songfinished == true) { // When song finishes jump to Drums through animation
            songfinished = false;
            vgmplayerStatus = false;
            animationstatus[screen] = true;
            oldsong = song;
          }
        }
        else {
          if (frameanimation[screen] < totalframeanimation[screen]) {
            Animation (screen, frameanimation[screen], totalframeanimation[screen]);
            frameanimation[screen]++;
          }
          else {
            frameanimation[screen] = 0;
            animationstatus[screen] = false;
            firsttime[screen] = true;
            screen = 1;
          }
        }
      }
      break;

    case (3):
      if (song < 7) {
        channel2LED();
        vgmplayerStatus = true;
        if (songfinished == true) {
          song++;
          vgmpos = 0;
          songfinished = false;
        }
      }
      else{
        screen=0;
        vgmplayerStatus=false;
        // Which parameters do we need to reset?
      }
      break;
    default:
      break;
  }
}

void ShowOutput() {
  WriteLED(bytenote);
}

void Animation (int screennumber, int framenumber, int totalframenumber) {
  switch (screennumber) {
    case (0):
    case (1):
    case (2):
      if (framenumber < ((totalframenumber / 8) * 1)) {
        bytenote = B00001000;
      }
      if ((framenumber > ((totalframenumber / 8) * 1)) && (framenumber < ((totalframenumber / 8) * 2))) {
        bytenote = B00011100;
      }
      if ((framenumber > ((totalframenumber / 8) * 2)) && (framenumber < ((totalframenumber / 8) * 3))) {
        bytenote = B00110110;
      }
      if ((framenumber > ((totalframenumber / 8) * 3)) && (framenumber < ((totalframenumber / 8) * 4))) {
        bytenote = B01100011;
      }
      if ((framenumber > ((totalframenumber / 8) * 4)) && (framenumber < ((totalframenumber / 8) * 5))) {
        bytenote = B01000001;
      }
      if ((framenumber > ((totalframenumber / 8) * 5)) && (framenumber < ((totalframenumber / 8) * 6))) {
        bytenote = B01100011;
      }
      if ((framenumber > ((totalframenumber / 8) * 6)) && (framenumber < ((totalframenumber / 8) * 7))) {
        bytenote = B00110110;
      }
      if ((framenumber > ((totalframenumber / 8) * 7)) && (framenumber < ((totalframenumber / 8) * 8))) {
        bytenote = B00001000;
      }
      break;
    default:
      break;
  }
}


void channel2LED() {
  int framesON = 5; // At 50 Hz --> 5 frames = 100 ms
  bytenote = B00000000;
  for (int i = 0; i < 6; i++) {
    if (channelstatus[i] == true) {
      if (framechannel[i] < framesON) {
        bytenote = bytenote + LEDbyte(i);
        framechannel[i]++;
      }
      else {
        channelstatus[i] = false;
        framechannel[i] = 0;
      }
    }
  }
}


byte LEDbyte(int channelLED) {
  switch (channelLED) {
    case (0):
      return B00010100;
      break;
    case (1):
      return B00001000;
      break;
    case (2):
      return B01000001;
      break;
    case (3):
      return B00100010;
      break;
    case (4):
      //return B00100010;
      return 0;
      break;
    case (5):
      //return B00100010;
      return 0;
      break;
    default:
      break;
  }
}

